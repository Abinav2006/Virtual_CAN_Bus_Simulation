VERSION ""

NS_ :

BS_:

BU_: SPEED_ECU DASHBOARD_ECU BRAKE_ECU

BO_ 256 SpeedData: 8 SPEED_ECU
 SG_ VehicleSpeed : 0|16@1+ (0.01,0) [0|655.35] "km/h" DASHBOARD_ECU

BO_ 128 BrakeData: 8 BRAKE_ECU
 SG_ BrakePressure : 0|16@1+ (0.1,0) [0|6553.5] "bar" DASHBOARD_ECU

BO_ 257 RPMData: 8 SPEED_ECU
 SG_ EngineRPM : 0|16@1+ (1,0) [0|65535] "rpm" DASHBOARD_ECU
